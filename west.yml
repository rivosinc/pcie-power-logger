## west.yml
```yaml
# Copyright (c) 2022 Rivos Inc.
# SPDX-License-Identifier: Apache-2.0

manifest:
  self:
    path: pcie-power-logger

  projects:
    - name: zephyr
      remote: zephyrproject-rtos
      revision: main
      import: true
```
