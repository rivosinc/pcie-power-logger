## CMakeLists.txt
```
# SPDX-FileCopyrightText: 2023 Rivos Inc.

# SPDX-License-Identifier: Apache-2.0

cmake_minimum_required(VERSION 3.20.0)

find_package(Zephyr REQUIRED HINTS $ENV{ZEPHYR_BASE})
project(hello_world)

FILE(GLOB app_sources src/*.c)
target_sources(app PRIVATE ${app_sources})
```

## prj.conf
```kconfig
# SPDX-FileCopyrightText: 2023 Rivos Inc.
#
# SPDX-License-Identifier: Apache-2.0

CONFIG_I2C=y

# General config
CONFIG_NEWLIB_LIBC=y

# Networking config
CONFIG_NETWORKING=y
CONFIG_NET_IPV4=y
CONFIG_NET_IPV6=n
CONFIG_NET_TCP=y
CONFIG_NET_TCP_ISN_RFC6528=n
CONFIG_NET_SOCKETS=y
CONFIG_NET_SOCKETS_POSIX_NAMES=y

# Network address config
CONFIG_NET_CONFIG_SETTINGS=y
CONFIG_NET_CONFIG_AUTO_INIT=n
CONFIG_NET_DHCPV4=y

CONFIG_ETH_STM32_HAL_USER_STATIC_MAC=y
CONFIG_ETH_STM32_HAL_RANDOM_MAC=n
CONFIG_ETH_STM32_HAL_MAC3=0x37
CONFIG_ETH_STM32_HAL_MAC4=0xfc
CONFIG_ETH_STM32_HAL_MAC5=0x3e

# Networking tweaks
# Required to handle large number of consecutive connections,
# e.g. when testing with ApacheBench.
CONFIG_NET_TCP_TIME_WAIT_DELAY=0

# Network debug config
CONFIG_NET_LOG=y

# Use 10us ticks to match our desired entry timestamp resolution.
CONFIG_SYS_CLOCK_TICKS_PER_SEC=100000
```

## src/http_server.c
```c
/*
 * SPDX-FileCopyrightText: 2023 Rivos Inc.
 *
 * SPDX-License-Identifier: Apache-2.0
 */

/*
 * HTTP server task implementation, derived from Zephyr dumb_http_server
 * sample code. This code listens for a client connection and then sends all
 * available buffered data in a compressed format.
 */
#include <stdio.h>
#include <stdlib.h>
#include <errno.h>

#include <zephyr/kernel.h>
#include <zephyr/net/net_config.h>
#include <zephyr/net/net_pkt.h>
#include <zephyr/net/socket.h>

#include "ringbuffer.h"
#include "tasks.h"
#include "wire_structs.h"

#define BIND_PORT 8080

#define CHECK(r) { if (r == -1) { printf("Error: " #r "\n"); exit(1); } }

void http_task(void)
{
	int serv;
	struct sockaddr_in bind_addr;
	static int counter;
	int ret;

	do {
		ret = net_config_init_app(NULL, "Initializing network");
	} while (ret < 0);

	serv = socket(AF_INET, SOCK_STREAM, IPPROTO_TCP);
	CHECK(serv);

	bind_addr.sin_family = AF_INET;
	bind_addr.sin_addr.s_addr = htonl(INADDR_ANY);
	bind_addr.sin_port = htons(BIND_PORT);
	CHECK(bind(serv, (struct sockaddr *)&bind_addr, sizeof(bind_addr)));

	CHECK(listen(serv, 5));

	printf("Single-threaded dumb HTTP server waits for a connection on "
		   "port %d...\n", BIND_PORT);

	while (1) {
		struct sockaddr_in client_addr;
		socklen_t client_addr_len = sizeof(client_addr);
		char addr_str[32];
		int req_state = 0;

		int client = accept(serv, (struct sockaddr *)&client_addr,
					&client_addr_len);
		if (client < 0) {
			printf("Error in accept: %d - continuing\n", errno);
			continue;
		}

		inet_ntop(client_addr.sin_family, &client_addr.sin_addr,
			  addr_str, sizeof(addr_str));
		printf("Connection #%d from %s\n", counter++, addr_str);

		/* Discard HTTP request (or otherwise client will get
		 * connection reset error).
		 */
		while (1) {
			ssize_t r;
			char c;

			r = recv(client, &c, 1, 0);
			if (r == 0) {
				goto close_client;
			}

			if (r < 0) {
				if (errno == EAGAIN || errno == EINTR) {
					continue;
				}

				printf("Got error %d when receiving from socket\n", errno);
				goto close_client;
			}
			if (req_state == 0 && c == '\r') {
				req_state++;
			} else if (req_state == 1 && c == '\n') {
				req_state++;
			} else if (req_state == 2 && c == '\r') {
				req_state++;
			} else if (req_state == 3 && c == '\n') {
				break;
			} else {
				req_state = 0;
			}
		}

		while (1) {
			struct wire_data_t wire_data;
			wire_data.reserved1 = wire_data.reserved2 = wire_data.reserved3 = 0;
			const int tx_buf_size = 128;
			struct wire_data_t tx_buf[tx_buf_size];
			int buffered_cnt = 0;

			index_t pop_idx = get_pop_idx();
			/* Stuff and send tx_buf until ringbuffer is empty. */
			while (buffered_cnt < tx_buf_size && pop_buffer(&wire_data.e)) {
				wire_data.entry_type =
					char_from_sample_t(sample_t_from_buffer_idx(pop_idx));
				memcpy(&tx_buf[buffered_cnt++], &wire_data, sizeof(wire_data));
				pop_idx = get_pop_idx();
			}
			if (buffered_cnt != 0) {
				send(client, tx_buf, buffered_cnt * sizeof(wire_data), 0);
			}
			if (buffered_cnt < tx_buf_size) break;
		}

close_client:
		ret = close(client);
		if (ret == 0) {
			printf("Connection from %s closed\n", addr_str);
		} else {
			printf("Got error %d while closing the socket\n", errno);
		}

	}
}

K_THREAD_DEFINE(http_task_id, STACK_SIZE * 16, http_task, NULL, NULL, NULL,
		HTTP_TASK_PRIORITY, 0, 0);
```

## src/i2c.c
```c
/*
 * SPDX-FileCopyrightText: 2023 Rivos Inc.
 *
 * SPDX-License-Identifier: Apache-2.0
 */

/*
 * I2C task implementation which continuously grabs current and voltage
 * measurement data from the PMD device and stuffs the data into a circular
 * buffer.
 */
#include <zephyr/drivers/i2c.h>

#include <stdio.h>
#include <zephyr/device.h>
#include <zephyr/kernel.h>

#include "ringbuffer.h"
#include "pmd.h"
#include "tasks.h"

void i2c_task(void) {
	const struct device *i2c_dev =
		DEVICE_DT_GET(DT_NODELABEL(i2c1));

	struct i2c_msg msgs[2];
	uint8_t rd_addr;
	uint8_t rd_data[2] = {0, 0};
	msgs[0].buf = &rd_addr;
	msgs[0].len = 1;
	msgs[0].flags = I2C_MSG_WRITE;

	msgs[1].buf = &rd_data[0];
	msgs[1].len = 2;
	msgs[1].flags = I2C_MSG_RESTART | I2C_MSG_READ | I2C_MSG_STOP;

	while (1) {
		rd_addr = i2c_addr_from_sample_t(
			sample_t_from_buffer_idx(get_push_idx()));
		int res = i2c_transfer(i2c_dev, &msgs[0], 2, PMD_I2C_ADDR);
		if (res != 0) {
			printf("I2C ERR %d %x %x\n", res, rd_data[0], rd_data[1]);
		} else {
			/* Store timestamp and raw ADC data. */
			struct entry e =
				{ (((uint32_t)k_uptime_ticks() << ENTRY_TIMESTAMP_SHIFT) &
				  ENTRY_TIMESTAMP_MASK) |
				((((rd_data[1] << 4) + (rd_data[0] >> 4)) << ENTRY_DATA_SHIFT) &
				  ENTRY_DATA_MASK) };
			push_buffer(e);
		}
	}
}

K_THREAD_DEFINE(i2c_task_id, STACK_SIZE, i2c_task, NULL, NULL, NULL,
		I2C_TASK_PRIORITY, 0, 0);
```

## src/pmd.h
```c
/*
 * SPDX-FileCopyrightText: 2023 Rivos Inc.
 *
 * SPDX-License-Identifier: Apache-2.0
 */

/* Definitions for ElmorLabs PMD, taken from device datasheet. */
#ifndef __PMD_H__
#define __PMD_H__

#include <zephyr.h>

#define PMD_I2C_ADDR 0x12

#define PMD_PCIE1_VOLTAGE_I2C_CMD 0x3
#define PMD_PCIE1_CURRENT_I2C_CMD 0x5
#define PMD_PCIE2_VOLTAGE_I2C_CMD 0x7
#define PMD_PCIE2_CURRENT_I2C_CMD 0x9
#define PMD_EPS1_VOLTAGE_I2C_CMD 0xb
#define PMD_EPS1_CURRENT_I2C_CMD 0xd
#define PMD_EPS2_VOLTAGE_I2C_CMD 0xf
#define PMD_EPS2_CURRENT_I2C_CMD 0x11

/* Alternate / undocumented regs that implement latching in newer PMD FW. */
#define PMD_PCIE1_VOLTAGE_ALT_I2C_CMD 0x80
#define PMD_PCIE1_CURRENT_ALT_I2C_CMD 0x82
#define PMD_PCIE2_VOLTAGE_ALT_I2C_CMD 0x84
#define PMD_PCIE2_CURRENT_ALT_I2C_CMD 0x86
#define PMD_EPS1_VOLTAGE_ALT_I2C_CMD 0x88
#define PMD_EPS1_CURRENT_ALT_I2C_CMD 0x8a
#define PMD_EPS2_VOLTAGE_ALT_I2C_CMD 0x8c
#define PMD_EPS2_CURRENT_ALT_I2C_CMD 0x8e

#endif /* __PMD_H__ */
```

## src/ringbuffer.c
```c
/*
 * SPDX-FileCopyrightText: 2023 Rivos Inc.
 *
 * SPDX-License-Identifier: Apache-2.0
 */

/*
 * Circular buffer implementation for (quickly) storing and retrieving entries.
 * In order for this code to work correctly without locking, push_buffer() must
 * only be called by Thread A, pop_buffer must only be called by Thread B, and
 * the loads + stores must be atomic.
 */
#include <zephyr/kernel.h>

#include "ringbuffer.h"

/* 2^16 entries means unsigned overflow eliminates need for mod operator. */
typedef uint16_t index_t;
static struct entry ring_buffer[65536];
static index_t push_idx = 0;
static index_t pop_idx = 0;

void push_buffer(struct entry e) {
	ring_buffer[push_idx++] = e;
}

bool pop_buffer(struct entry *e) {
	/* Overflow causes empty buffer. */
	if (push_idx == pop_idx) return false;
	*e = ring_buffer[pop_idx++];
	return true;
}

/*
 * These functions allow the pusher and popper to store and retrieve  different
 * types of data (e.g., voltage and current) in the same ringbuffer without
 * using additional storage bits to distinguish between the types (e.g., store
 * voltage in even numbered idx, store current in odd numbered idx).
 */
index_t get_push_idx() {
	return push_idx;
}

index_t get_pop_idx() {
	return pop_idx;
}
```

## src/ringbuffer.h
```c
/*
 * SPDX-FileCopyrightText: 2023 Rivos Inc.
 *
 * SPDX-License-Identifier: Apache-2.0
 */

#ifndef __RINGBUFFER_H__
#define __RINGBUFFER_H__

#include <zephyr/kernel.h>

/*
 * Entry data is stored in ringbuffer and sent directly on the wire. Embedded
 * code does not decode it, decoding is done completely on client-side.
 */
struct entry {
	// uint32_t timestamp_ticks : 20;
	// uint16_t raw_data : 12;
	uint32_t bits;
} __packed;

#define ENTRY_TIMESTAMP_MASK 0xfffff000
#define ENTRY_TIMESTAMP_SHIFT 12
#define ENTRY_DATA_MASK 0xfff
#define ENTRY_DATA_SHIFT 0

typedef uint16_t index_t;

void push_buffer(struct entry e);
index_t get_push_idx();

bool pop_buffer(struct entry *e);
index_t get_pop_idx();

#endif /* __RINGBUFFER_H__ */
```

## src/tasks.h
```c
/*
 * SPDX-FileCopyrightText: 2023 Rivos Inc.
 *
 * SPDX-License-Identifier: Apache-2.0
 */

#ifndef __TASKS_H__
#define __TASKS_H__

#include "pmd.h"
#include "ringbuffer.h"

#include <zephyr.h>

#define STACK_SIZE 1024

/*
 * Try to maximize I2C bus usage by making the I2C task higher priority. The
 * HTTP process should be able to consume / send data at a rate much faster than
 * the I2C process can produce it (~10 KB / sec * 8 bytes per entry).
 */
#define I2C_TASK_PRIORITY 6
#define HTTP_TASK_PRIORITY 7

/*
 * Number of input channels to monitor on PMD.
 * 1 = PCIE1 only.
 * 2 = PCIE1 and PCIE2.
 */
#define INPUT_CHANNELS 2
/*
 * Record 31 current samples for every 1 voltage sample since voltage usually
 * changes at a slower rate.
 */
#define VOLTAGE_IDX 32

BUILD_ASSERT(INPUT_CHANNELS == 1 || INPUT_CHANNELS == 2);

enum sample_t {
	PCIE1_VOLTAGE,
	PCIE2_VOLTAGE,
	PCIE1_CURRENT,
	PCIE2_CURRENT,
};

static inline enum sample_t sample_t_from_buffer_idx(index_t idx) {
	bool voltage = (idx % VOLTAGE_IDX) == 0;
	if (voltage) {
		return (idx % (VOLTAGE_IDX * INPUT_CHANNELS)) == 0
			? PCIE1_VOLTAGE : PCIE2_VOLTAGE;
	} else {
	return (idx % INPUT_CHANNELS == 0) ? PCIE1_CURRENT : PCIE2_CURRENT;
	}
}

static inline uint8_t i2c_addr_from_sample_t(enum sample_t sample) {
	switch (sample) {
		case PCIE1_VOLTAGE: return PMD_PCIE1_VOLTAGE_ALT_I2C_CMD; break;
		case PCIE2_VOLTAGE: return PMD_PCIE2_VOLTAGE_ALT_I2C_CMD; break;
		case PCIE1_CURRENT: return PMD_PCIE1_CURRENT_ALT_I2C_CMD; break;
		case PCIE2_CURRENT: return PMD_PCIE2_CURRENT_ALT_I2C_CMD; break;
	}
	return 0;
}

static inline char char_from_sample_t(enum sample_t sample) {
	switch (sample) {
		case PCIE1_VOLTAGE: return 'V'; break;
		case PCIE2_VOLTAGE: return 'W'; break;
		case PCIE1_CURRENT: return 'I'; break;
		case PCIE2_CURRENT: return 'J'; break;
	}
	return 0;
}

#endif /* __TASKS_H__ */
```

## src/wire_structs.h
```c
/*
 * SPDX-FileCopyrightText: 2023 Rivos Inc.
 *
 * SPDX-License-Identifier: Apache-2.0
 */

/* Structs sent over wire to http client. */

#ifndef __WIRE_STRUCTS_H__
#define __WIRE_STRUCTS_H__

#include <zephyr/kernel.h>

#include "ringbuffer.h"

struct wire_data_t {
	/* 20 bits timestamp, 12 bits raw ADC data. */
	struct entry e;
	/*
	 * Current time for synchronization: 'T'.
	 * PCIE1: 'I' (current) or 'V' (voltage).
	 * PCIE2: 'J' (current) or 'W' (voltage).
	 */
	uint8_t entry_type;
	uint8_t reserved1;
	uint8_t reserved2;
	uint8_t reserved3;
} __packed;

BUILD_ASSERT(sizeof(struct wire_data_t) == 8);

#endif /* __WIRE_STRUCTS_H__ */
```
